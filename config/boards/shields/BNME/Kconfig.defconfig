## config/boards/shields/BNME/Kconfig.defconfig
```kconfig
if SHIELD_BNME_LEFT

config ZMK_KEYBOARD_NAME
    default "BNME"

config ZMK_SPLIT_ROLE_CENTRAL
    default y

endif

if SHIELD_BNME_LEFT || SHIELD_BNME_RIGHT

config ZMK_SPLIT
    default y

endif
```

## config/boards/shields/BNME/Kconfig.shield
```kconfig
# Copyright (c) 2020 Pete Johanson
# SPDX-License-Identifier: MIT

config SHIELD_BNME_LEFT
    def_bool $(shields_list_contains,BNME_left)

config SHIELD_BNME_RIGHT
    def_bool $(shields_list_contains,BNME_right)
```
